## Devices/Mosaico/main/Kconfig.projbuild
```kconfig
menu "Cardenza Mosaico minimal port"
    config CARDENZA_MOSAICO_AUDIO_TEST
        bool "Play a short synth/sequencer test once after boot"
        default y
        help
            Uses the existing Juno track, MIDI routing, sequencer and RenderFrames
            callback for a short C-E-G phrase, then stops. No keyboard driver is
            installed and nothing is saved. Disable for a silent idle boot.
    config CARDENZA_MOSAICO_TEST_VOLUME
        int "Boot output volume (percent)"
        range 0 100
        default 20
endmenu
```

## Devices/Mosaico/sdkconfig.defaults
```kconfig
CONFIG_IDF_TARGET="esp32s31"
CONFIG_IDF_EXPERIMENTAL_FEATURES=y
CONFIG_COMPILER_OPTIMIZATION_PERF=y
CONFIG_ESPTOOLPY_FLASHMODE_QIO=y
CONFIG_ESPTOOLPY_FLASHSIZE_16MB=y
CONFIG_PARTITION_TABLE_CUSTOM=y
CONFIG_PARTITION_TABLE_CUSTOM_FILENAME="partitions.csv"
CONFIG_BOOTLOADER_APP_ROLLBACK_ENABLE=y
CONFIG_ESP_COREDUMP_ENABLE_TO_FLASH=y
CONFIG_APP_RETRIEVE_LEN_ELF_SHA=64
CONFIG_FACTORY_RECOVERY_BOOT_GPIO=7
CONFIG_FACTORY_RECOVERY_BOOT_DEBOUNCE_MS=50
CONFIG_ESP_CONSOLE_UART_DEFAULT=y
# CONFIG_ESP_CONSOLE_USB_SERIAL_JTAG is not set
CONFIG_ESP_CONSOLE_SECONDARY_NONE=y
CONFIG_SPIRAM=y
CONFIG_SPIRAM_SPEED_250M=y
CONFIG_SPIRAM_XIP_FROM_PSRAM=y
# CONFIG_SPIRAM_MEMTEST is not set
CONFIG_SPIRAM_MALLOC_ALWAYSINTERNAL=4096
CONFIG_SPIRAM_MALLOC_RESERVE_INTERNAL=65536
CONFIG_FREERTOS_HZ=1000
CONFIG_FREERTOS_ISR_STACKSIZE=4096
CONFIG_ESP_MAIN_TASK_STACK_SIZE=8192
CONFIG_ESP_TASK_WDT_INIT=y
CONFIG_ESP_TASK_WDT_PANIC=y
CONFIG_ESP_TASK_WDT_TIMEOUT_S=10
CONFIG_BSP_DISPLAY_ENABLE=y
# CONFIG_BSP_DISPLAY_LVGL_ENABLE is not set
# CONFIG_BSP_CO5300_ENABLE_TE is not set
```

## Devices/MosaicoNative/components/esp-mosaico-bsp/Kconfig
```kconfig
rsource "../../../../tools/mosaico-vibe/submodule/esp-mosaico-bsp/components/esp-mosaico-bsp/Kconfig"
```

## Devices/MosaicoNative/main/Kconfig.projbuild
```kconfig
menu "Mosaico Native"
    config CARDENZA_NATIVE_MIC_SLOT
        int "ES8311 active microphone I2S slot"
        range 0 1
        default 0
        help
            Select the board's ADC slot without averaging a valid slot with silence.
endmenu
```
